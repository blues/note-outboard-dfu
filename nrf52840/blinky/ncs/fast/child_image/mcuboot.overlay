/ {

	buttons {
		compatible = "gpio-keys";
		buttonDFU: button_dfu {
			gpios = <&gpio0 10 (GPIO_PULL_UP | GPIO_ACTIVE_LOW)>;
			label = "DFU activation button";
		};
	};


	aliases {
		mcuboot-led0 = &led0;
//		mcuboot-button0 = &button0;	// to use the onboard button on the Adafruit nRF52840 Feather Express

		// use the pin defined above to enter boot mode.
		mcuboot-button0 = &buttonDFU;
	};
};
